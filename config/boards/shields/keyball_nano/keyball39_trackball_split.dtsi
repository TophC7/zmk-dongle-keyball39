/*
 * Copyright (c) 2024 ZMK Contributors
 * SPDX-License-Identifier: MIT
 *
 * Shared trackball configuration for Keyball39 split keyboard
 * This file is included by both central and peripheral overlays
 */

/ {
    /* Parent node with proper address cells for input-split */
    split_inputs {
        #address-cells = <1>;
        #size-cells = <0>;

        /* Input split device for the trackball on left peripheral */
        trackball_split: trackball_split@0 {
            compatible = "zmk,input-split";
            reg = <0>;
            /* Device reference will be set in peripheral overlay */
        };
    };

    /* Listener for trackball events - disabled by default */
    /* Will be enabled on central/dongle only */
    trackball_listener: trackball_listener {
        compatible = "zmk,input-listener";
        status = "disabled";
        device = <&trackball_split>;
    };
};